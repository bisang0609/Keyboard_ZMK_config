## boards/shields/tomak79/Kconfig.defconfig
```kconfig
if SHIELD_TOMAK79_LEFT || SHIELD_TOMAK79_RIGHT || SHIELD_TOMAK79_DONGLE || SHIELD_TOMAK79_DONGLE_SSD1306_BLOCK || SHIELD_TOMAK79_DONGLE_ST7789_TEST || SHIELD_TOMAK79_DONGLE_YADS

config ZMK_KEYBOARD_NAME
    default "Tomak79"

config ZMK_SPLIT
    default y

if ZMK_DISPLAY && (SHIELD_TOMAK79_DONGLE || SHIELD_TOMAK79_DONGLE_SSD1306_BLOCK)

config I2C
    default y

config SSD1306
    default y

endif # ZMK_DISPLAY && SSD1306 shields

if LVGL && (SHIELD_TOMAK79_DONGLE || SHIELD_TOMAK79_DONGLE_SSD1306_BLOCK)

config LV_Z_VDB_SIZE
    default 64

config LV_DPI_DEF
    default 148

config LV_Z_BITS_PER_PIXEL
    default 1

choice LV_COLOR_DEPTH
    default LV_COLOR_DEPTH_1
endchoice

endif # LVGL && SSD1306 shields

endif
```

## boards/shields/tomak79/Kconfig.shield
```kconfig
config SHIELD_TOMAK79_LEFT
    def_bool $(shields_list_contains,tomak79_left)

config SHIELD_TOMAK79_RIGHT
    def_bool $(shields_list_contains,tomak79_right)

config SHIELD_TOMAK79_DONGLE
    def_bool $(shields_list_contains,tomak79_dongle)

config SHIELD_TOMAK79_DONGLE_SSD1306_BLOCK
    def_bool $(shields_list_contains,tomak79_dongle_ssd1306_block)

config SHIELD_TOMAK79_DONGLE_SSH1106
    def_bool $(shields_list_contains,tomak79_dongle_ssh1106)

config SHIELD_TOMAK79_DONGLE_SSH1106_ENCODER
    def_bool $(shields_list_contains,tomak79_dongle_ssh1106_encoder)

config SHIELD_TOMAK79_DONGLE_YADS
    def_bool $(shields_list_contains,tomak79_dongle_yads)

config SHIELD_TOMAK79_DONGLE_YADS_ENCODER
    def_bool $(shields_list_contains,tomak79_dongle_yads_encoder)
```
