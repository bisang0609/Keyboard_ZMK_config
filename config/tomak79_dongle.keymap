#include <behaviors.dtsi>
#include <dt-bindings/zmk/keys.h>

/ {
    keymap {
        compatible = "zmk,keymap";

#if defined(CONFIG_SHIELD_TOMAK79_DONGLE_YADS_ENCODER)
        default_layer {
            bindings = <&mo 1>;
            sensor-bindings = <&inc_dec_kp C_VOL_UP C_VOL_DN>;
        };

        wake_layer {
            bindings = <&trans>;
            sensor-bindings = <&inc_dec_kp C_VOL_UP C_VOL_DN>;
        };
#else
        default_layer {
            bindings = <
                &none &none &none &none &none &none &none &none &none &none &none &none &none &none &none
                &none &none &none &none &none &none &none &none &none &none &none &none &none &none &none &none
                &none &none &none &none &none &none &none &none &none &none &none &none &none &none &none
                &none &none &none &none &none &none &none &none &none &none &none &none &none &none
                &none &none &none &none &none &none &none &none &none &none &none &none &none
                &none
                &none &none &none &none &none
                &none &none &none &none &none &none
            >;
        };
#endif
    };
};
