## build/origin/settings_reset_nice_nano_v2/Kconfig/Kconfig.shield
```kconfig
osource "/home/bisang0609/ZMK_Keyboard/Keyboard_ZMK_config/boards/shields/*/Kconfig.shield"
osource "/home/bisang0609/ZMK_Keyboard/zmk-dongle-display/boards/shields/*/Kconfig.shield"
osource "/home/bisang0609/ZMK_Keyboard/zmk-dongle-screen/boards/shields/*/Kconfig.shield"
osource "/home/bisang0609/ZMK_Keyboard/zmk/app/boards/shields/*/Kconfig.shield"
osource "/home/bisang0609/ZMK_Keyboard/Keyboard_ZMK_config/boards/shields/*/Kconfig.shield"
```

## build/origin/tomak79_dongle_ssh1106_encoder/Kconfig/Kconfig.shield.defconfig
```kconfig
osource "/home/bisang0609/ZMK_Keyboard/Keyboard_ZMK_config/boards/shields/*/Kconfig.defconfig"
osource "/home/bisang0609/ZMK_Keyboard/zmk/app/boards/shields/*/Kconfig.defconfig"
```

## build/origin/tomak79_left/Kconfig/Kconfig.shield.defconfig
```kconfig
osource "/home/bisang0609/ZMK_Keyboard/Keyboard_ZMK_config/boards/shields/*/Kconfig.defconfig"
osource "/home/bisang0609/ZMK_Keyboard/zmk-dongle-display/boards/shields/*/Kconfig.defconfig"
osource "/home/bisang0609/ZMK_Keyboard/zmk-dongle-screen/boards/shields/*/Kconfig.defconfig"
osource "/home/bisang0609/ZMK_Keyboard/zmk/app/boards/shields/*/Kconfig.defconfig"
osource "/home/bisang0609/ZMK_Keyboard/Keyboard_ZMK_config/boards/shields/*/Kconfig.defconfig"
```

## build/origin/tomak79_right2/Kconfig/Kconfig.modules
```kconfig
menu "acpica (/home/bisang0609/ZMK_Keyboard/modules/lib/acpica)"
osource "$(ZEPHYR_ACPICA_KCONFIG)"
config ZEPHYR_ACPICA_MODULE
	bool
	default y
endmenu
menu "canopennode (/home/bisang0609/ZMK_Keyboard/modules/lib/canopennode)"
osource "$(ZEPHYR_CANOPENNODE_KCONFIG)"
config ZEPHYR_CANOPENNODE_MODULE
	bool
	default y
endmenu
menu "cmsis (/home/bisang0609/ZMK_Keyboard/modules/hal/cmsis)"
osource "$(ZEPHYR_CMSIS_KCONFIG)"
config ZEPHYR_CMSIS_MODULE
	bool
	default y
endmenu
menu "cmsis-dsp (/home/bisang0609/ZMK_Keyboard/modules/lib/cmsis-dsp)"
osource "$(ZEPHYR_CMSIS_DSP_KCONFIG)"
config ZEPHYR_CMSIS_DSP_MODULE
	bool
	default y
endmenu
menu "cmsis-nn (/home/bisang0609/ZMK_Keyboard/modules/lib/cmsis-nn)"
osource "$(ZEPHYR_CMSIS_NN_KCONFIG)"
config ZEPHYR_CMSIS_NN_MODULE
	bool
	default y
endmenu
menu "fatfs (/home/bisang0609/ZMK_Keyboard/modules/fs/fatfs)"
osource "$(ZEPHYR_FATFS_KCONFIG)"
config ZEPHYR_FATFS_MODULE
	bool
	default y
endmenu
menu "hal_ambiq (/home/bisang0609/ZMK_Keyboard/modules/hal/ambiq)"
osource "$(ZEPHYR_HAL_AMBIQ_KCONFIG)"
config ZEPHYR_HAL_AMBIQ_MODULE
	bool
	default y
endmenu
menu "hal_espressif (/home/bisang0609/ZMK_Keyboard/modules/hal/espressif)"
osource "/home/bisang0609/ZMK_Keyboard/modules/hal/espressif/zephyr/Kconfig"
config ZEPHYR_HAL_ESPRESSIF_MODULE
	bool
	default y
endmenu
menu "hal_ethos_u (/home/bisang0609/ZMK_Keyboard/modules/hal/ethos_u)"
osource "$(ZEPHYR_HAL_ETHOS_U_KCONFIG)"
config ZEPHYR_HAL_ETHOS_U_MODULE
	bool
	default y
endmenu
menu "hal_gigadevice (/home/bisang0609/ZMK_Keyboard/modules/hal/gigadevice)"
osource "$(ZEPHYR_HAL_GIGADEVICE_KCONFIG)"
config ZEPHYR_HAL_GIGADEVICE_MODULE
	bool
	default y
endmenu
menu "hal_nordic (/home/bisang0609/ZMK_Keyboard/modules/hal/nordic)"
osource "$(ZEPHYR_HAL_NORDIC_KCONFIG)"
config ZEPHYR_HAL_NORDIC_MODULE
	bool
	default y
endmenu
menu "hal_rpi_pico (/home/bisang0609/ZMK_Keyboard/modules/hal/rpi_pico)"
osource "$(ZEPHYR_HAL_RPI_PICO_KCONFIG)"
config ZEPHYR_HAL_RPI_PICO_MODULE
	bool
	default y
endmenu
menu "hal_telink (/home/bisang0609/ZMK_Keyboard/modules/hal/telink)"
osource "/home/bisang0609/ZMK_Keyboard/modules/hal/telink/Kconfig"
config ZEPHYR_HAL_TELINK_MODULE
	bool
	default y
endmenu
menu "liblc3 (/home/bisang0609/ZMK_Keyboard/modules/lib/liblc3)"
osource "$(ZEPHYR_LIBLC3_KCONFIG)"
config ZEPHYR_LIBLC3_MODULE
	bool
	default y
endmenu
menu "littlefs (/home/bisang0609/ZMK_Keyboard/modules/fs/littlefs)"
osource "$(ZEPHYR_LITTLEFS_KCONFIG)"
config ZEPHYR_LITTLEFS_MODULE
	bool
	default y
endmenu
menu "lvgl (/home/bisang0609/ZMK_Keyboard/modules/lib/gui/lvgl)"
osource "/home/bisang0609/ZMK_Keyboard/modules/lib/gui/lvgl/Kconfig"
config ZEPHYR_LVGL_MODULE
	bool
	default y
endmenu
menu "mbedtls (/home/bisang0609/ZMK_Keyboard/modules/crypto/mbedtls)"
osource "$(ZEPHYR_MBEDTLS_KCONFIG)"
config ZEPHYR_MBEDTLS_MODULE
	bool
	default y
endmenu
menu "percepio (/home/bisang0609/ZMK_Keyboard/modules/debug/percepio)"
osource "/home/bisang0609/ZMK_Keyboard/modules/debug/percepio/zephyr/Kconfig"
config ZEPHYR_PERCEPIO_MODULE
	bool
	default y
endmenu
menu "picolibc (/home/bisang0609/ZMK_Keyboard/modules/lib/picolibc)"
osource "/home/bisang0609/ZMK_Keyboard/modules/lib/picolibc/zephyr/Kconfig"
config ZEPHYR_PICOLIBC_MODULE
	bool
	default y
endmenu
menu "segger (/home/bisang0609/ZMK_Keyboard/modules/debug/segger)"
osource "$(ZEPHYR_SEGGER_KCONFIG)"
config ZEPHYR_SEGGER_MODULE
	bool
	default y
endmenu
menu "trusted-firmware-a (/home/bisang0609/ZMK_Keyboard/modules/tee/tf-a/trusted-firmware-a)"
osource "$(ZEPHYR_TRUSTED_FIRMWARE_A_KCONFIG)"
config ZEPHYR_TRUSTED_FIRMWARE_A_MODULE
	bool
	default y
endmenu
menu "uoscore-uedhoc (/home/bisang0609/ZMK_Keyboard/modules/lib/uoscore-uedhoc)"
osource "$(ZEPHYR_UOSCORE_UEDHOC_KCONFIG)"
config ZEPHYR_UOSCORE_UEDHOC_MODULE
	bool
	default y
endmenu
menu "zcbor (/home/bisang0609/ZMK_Keyboard/modules/lib/zcbor)"
osource "$(ZEPHYR_ZCBOR_KCONFIG)"
config ZEPHYR_ZCBOR_MODULE
	bool
	default y
endmenu
menu "module (/home/bisang0609/ZMK_Keyboard/zmk/app/module)"
osource "/home/bisang0609/ZMK_Keyboard/zmk/app/module/Kconfig"
config ZEPHYR_MODULE_MODULE
	bool
	default y
endmenu
```

## build/origin/tomak79_right2/Kconfig/Kconfig.shield
```kconfig
osource "/home/bisang0609/ZMK_Keyboard/Keyboard_ZMK_config/boards/shields/*/Kconfig.shield"
osource "/home/bisang0609/ZMK_Keyboard/zmk/app/boards/shields/*/Kconfig.shield"
```

## west.yml
```yaml
manifest:
  remotes:
    - name: zmkfirmware
      url-base: https://github.com/zmkfirmware
    - name: englmaxi
      url-base: https://github.com/englmaxi
    - name: janpfischer
      url-base: https://github.com/janpfischer
    - name: mctechnology17
      url-base: https://github.com/mctechnology17
  projects:
    - name: zmk
      remote: zmkfirmware
      revision: v0.3
      import: app/west.yml
    - name: zmk-dongle-display
      remote: englmaxi
      revision: v0.3
    - name: zmk-dongle-screen
      remote: janpfischer
      revision: main
    - name: zmk-oled-adapter
      remote: mctechnology17
      revision: main
  self:
    path: Keyboard_ZMK_config
```
